## software/carlos_baza/main/Kconfig.projbuild
```kconfig
menu "CARLOS - piny silników"

    menu "Koło przednie lewe (FL)"
        config WHEEL_FL_IN1_GPIO
            int "IN1 GPIO"
            range 0 54
            default 5
        config WHEEL_FL_IN2_GPIO
            int "IN2 GPIO"
            range 0 54
            default 20
        config WHEEL_FL_MCPWM_GROUP
            int "Grupa MCPWM"
            range 0 1
            default 0
    endmenu

    menu "Koło przednie prawe (FR)"
        config WHEEL_FR_IN1_GPIO
            int "IN1 GPIO"
            range 0 54
            default 32
        config WHEEL_FR_IN2_GPIO
            int "IN2 GPIO"
            range 0 54
            default 33
        config WHEEL_FR_MCPWM_GROUP
            int "Grupa MCPWM"
            range 0 1
            default 0
    endmenu

    menu "Koło tylne lewe (BL)"
        config WHEEL_BL_IN1_GPIO
            int "IN1 GPIO"
            range 0 54
            default 3
        config WHEEL_BL_IN2_GPIO
            int "IN2 GPIO"
            range 0 54
            default 4
        config WHEEL_BL_MCPWM_GROUP
            int "Grupa MCPWM"
            range 0 1
            default 1
    endmenu

    menu "Koło tylne prawe (BR)"
        config WHEEL_BR_IN1_GPIO
            int "IN1 GPIO"
            range 0 54
            default 1
        config WHEEL_BR_IN2_GPIO
            int "IN2 GPIO"
            range 0 54
            default 2
        config WHEEL_BR_MCPWM_GROUP
            int "Grupa MCPWM"
            range 0 1
            default 1
    endmenu

endmenu
```
